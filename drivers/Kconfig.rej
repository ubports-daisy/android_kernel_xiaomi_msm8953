## drivers/Kconfig.rej
```kconfig
diff a/drivers/Kconfig b/drivers/Kconfig	(rejected hunks)
@@ -208,6 +208,8 @@ source "drivers/fpga/Kconfig"
 
 source "drivers/firmware/Kconfig"
 
+source "drivers/anbox/Kconfig"
+
 source "drivers/bif/Kconfig"
 
 source "drivers/sensors/Kconfig"
```
